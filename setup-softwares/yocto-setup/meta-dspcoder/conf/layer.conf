## setup-softwares/yocto-setup/meta-dspcoder/conf/layer.conf
```bitbake
BBPATH .= ":${LAYERDIR}"
BBFILES += "${LAYERDIR}/recipes-*/*/*.bb"

BBFILE_COLLECTIONS += "dspcoder"
BBFILE_PATTERN_dspcoder := "^${LAYERDIR}/"

BBFILE_PRIORITY_dspcoder = "6"

# Add systemd to distro features
DISTRO_FEATURES:append = " systemd"
VIRTUAL-RUNTIME_init_manager = "systemd"
VIRTUAL-RUNTIME_initscripts = ""
DISTRO_FEATURES_BACKFILL_CONSIDERED += "sysvinit"
VIRTUAL-RUNTIME_login_manager = "systemd"

# layer compatibility
LAYER_COMPATIBLE_MACHINE = "(qemux86)"
LINUX_VERSION_EXTENSION ?= "-dspLinux"

# change image hostname
hostname:pn-base-files = "dspcoder"

# additional packages
IMAGE_INSTALL:append = " kmod gcc make binutils packagegroup-core-buildessential"
```
